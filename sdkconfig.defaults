## sdkconfig.defaults
```kconfig
# ESP-IDF 5.5.x project minimal configuration (argimbss, fork di aRgiModGw)
CONFIG_BOOTLOADER_APP_ROLLBACK_ENABLE=y
CONFIG_ESPTOOLPY_FLASHSIZE_4MB=y
CONFIG_PARTITION_TABLE_CUSTOM=y
CONFIG_PARTITION_TABLE_CUSTOM_FILENAME="partitions.csv"
CONFIG_PARTITION_TABLE_FILENAME="partitions.csv"
CONFIG_ESP_DEFAULT_CPU_FREQ_MHZ_240=y
CONFIG_FREERTOS_HZ=1000
CONFIG_FREERTOS_GENERATE_RUN_TIME_STATS=y
CONFIG_LOG_VERSION_2=y
CONFIG_LOG_MAXIMUM_LEVEL_VERBOSE=y
CONFIG_LOG_TIMESTAMP_SOURCE_SYSTEM_FULL=y
CONFIG_LWIP_MAX_SOCKETS=24
CONFIG_LWIP_MAX_ACTIVE_TCP=24
CONFIG_MBEDTLS_SSL_IN_CONTENT_LEN=6144
CONFIG_MBEDTLS_SSL_OUT_CONTENT_LEN=6144
CONFIG_MBEDTLS_SSL_PROTO_TLS1_3=y
CONFIG_FMB_MASTER_TIMEOUT_MS_RESPOND=1000
CONFIG_FMB_EXT_TYPE_SUPPORT=y
```
